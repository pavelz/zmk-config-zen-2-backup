## config/west.yml
```yaml
manifest:
  remotes:
    - name: zmkfirmware
      url-base: https://github.com/zmkfirmware
  projects:
    - name: zmk
      remote: zmkfirmware
      revision: 633718c8b10a734c67950f89044f4c6f79b99cc3
      import: app/west.yml
  self:
    path: config
```
